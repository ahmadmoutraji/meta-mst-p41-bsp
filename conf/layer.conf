## conf/machine/mst-p41-imx8mp.conf
```bitbake
#@TYPE: Machine
#@NAME: Toradex SMARC iMX8M Plus
#@SOC: i.MX8MP
#@DESCRIPTION: Machine configuration for Toradex SMARC iMX8M Plus SoM
#@MAINTAINER: Toradex Linux BSP Team <linux-bsp@toradex.com>

MACHINE_NAME = "SMARC-iMX8MP"
MACHINEOVERRIDES =. "tdx:mx8:mx8m:mx8mp:"
MACHINE_EXTRA_RRECOMMENDS:append = " mwifiexconf"
IMX_DEFAULT_BSP = "nxp"

require conf/machine/include/imx-base.inc
# override imx-base.inc which sets this to cortexa53-crypto
DEFAULTTUNE:mx8mp-generic-bsp = "armv8a-crypto"
require conf/machine/include/arm/armv8a/tune-cortexa53.inc

SERIAL_CONSOLES = "115200;ttymxc1"

MACHINE_FEATURES += "3g bluetooth alsa ext2 pci screen touchscreen tpm2 usbgadget usbhost vfat wifi"
INIT_MANAGER = "systemd"

KERNEL_DTB_PREFIX = "microsensytech/imx8mp-p41/"
KERNEL_DEVICETREE = " \
    ${KERNEL_DTB_PREFIX}microsensytech-smarc-imx8mp.dtb \
"

KERNEL_IMAGETYPE = "Image.gz"
PREFERRED_PROVIDER_virtual/kernel = "linux-toradex"
PREFERRED_VERSION_linux-imx-headers = "6.6"

KBUILD_DEFCONFIG = "mst_imx8_defconfig"

LOADADDR = ""
UBOOT_SUFFIX = "bin"
UBOOT_MAKE_TARGET = ""
IMX_BOOT_SEEK = "32"

UBOOT_CONFIG ??= "sd"
UBOOT_CONFIG[sd] = "microsensytech-imx8mp_defconfig,sdcard"
SPL_BINARY = "spl/u-boot-spl.bin"

UBOOT_DTB_LOADADDRESS = "0x50200000"
UBOOT_DTBO_LOADADDRESS = "0x50240000"
UBOOT_ENTRYPOINT:mx8mp-generic-bsp = "0x48200000"
UBOOT_RD_LOADADDRESS = "0x52300000"

# Set u-boot DTB
UBOOT_DTB_NAME = "microsensytech-smarc-imx8mp.dtb"

# Set DDR FIRMWARE
LPDDR_FW_VERSION = "_202006"
DDR_FIRMWARE_NAME = " \
    lpddr4_pmu_train_1d_dmem${LPDDR_FW_VERSION}.bin \
    lpddr4_pmu_train_1d_imem${LPDDR_FW_VERSION}.bin \
    lpddr4_pmu_train_2d_dmem${LPDDR_FW_VERSION}.bin \
    lpddr4_pmu_train_2d_imem${LPDDR_FW_VERSION}.bin \
"

ATF_PLATFORM = "imx8mp"
SOC_ATF_BOOT_UART_BASE:mst-p41-imx8mp = "0x30a60000"

BOOT_SPACE = "65536"

# Set imx-mkimage boot target
IMXBOOT_TARGETS = "flash_evk_emmc_fastboot"
IMX_BOOT_SOC_TARGET = "iMX8MP"

IMAGE_BOOT_FILES:append = " boot.scr-${MACHINE};boot.scr"
WKS_FILE_DEPENDS:append = " u-boot-default-script"
PREFERRED_PROVIDER_u-boot-default-script = "u-boot-distro-boot"

IMX_DEFAULT_BOOTLOADER = "u-boot-toradex"
# variables to control imx-boot with u-boot
ATF_LOAD_ADDR = "0x920000"
IMX_EXTRA_FIRMWARE = "firmware-imx-8m"
TEE_LOAD_ADDR = "0xbe000000"

# handle machine firmware
MACHINE_FIRMWARE:append = " linux-firmware-nxp8997-sdio"
MACHINE_FIRMWARE:remove = "firmware-sof-imx"
```
